## sample.yaml
```yaml
sample:
  description: Worker producer thread example
  name: app
common:
  tags: assignment
  integration_platforms:
    - native_sim
  harness: console
  harness_config:
    type: one_line
    regex:
      - "Hello World! (.*)"
tests:
  sample.basic.helloworld:
    tags: introduction
```
